## drivers/misc/mediatek/i2c/Kconfig
```kconfig
config MTK_LCM_BIAS_OCP2131
	bool "Enble OCP2131 driver"
	help
	  define OCP2131 driver config to enable OCP2131 driver.
	  To set LOCP2131 driver which you choose avoid cannot driver OCP2131.
	  Please make sure CONFIG_MTK_LCM_BIAS_OCP2131 in xxxxxx_defconfig.mk.
	  And also make sure true on in ProjectConfig.mk

config MTK_LCM_BACKLIGHT_SGM37604A
	bool "Enble SGM37604A driver"
	help
	  define SGM37604A driver config to enable SGM37604A driver.
	  To set SGM37604A driver which you choose avoid cannot driver SGM37604A.
	  Please make sure CONFIG_MTK_LCM_BACKLIGHT_SGM37604A in xxxxxx_defconfig.mk.
	  And also make sure true on in ProjectConfig.mk
```
